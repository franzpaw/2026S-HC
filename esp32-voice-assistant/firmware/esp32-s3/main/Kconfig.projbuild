## esp32-voice-assistant/firmware/esp32-s3/main/Kconfig.projbuild
```kconfig
menu "Voice Client"

    config VOICE_WIFI_SSID
        string "Wi-Fi SSID"
        default ""
        help
            Wi-Fi network name for station mode.

    config VOICE_WIFI_PASSWORD
        string "Wi-Fi password"
        default ""
        help
            Wi-Fi password for station mode.

    config VOICE_WIFI_MAX_RETRY
        int "Wi-Fi max retries"
        default 5
        range 1 20
        help
            Number of reconnect attempts before the boot-time Wi-Fi connect call fails.

    config VOICE_WIFI_CONNECT_TIMEOUT_MS
        int "Wi-Fi connect timeout in milliseconds"
        default 20000
        range 1000 120000
        help
            Maximum time to wait for a Wi-Fi connection during boot.

    config VOICE_BACKEND_BASE_URL
        string "Backend base URL"
        default "https://example.invalid"
        help
            Backend origin without a trailing slash, for example https://example.invalid.

    config VOICE_API_TOKEN
        string "Voice API bearer token"
        default ""
        help
            Bearer token used for backend requests.

    config VOICE_BACKEND_TIMEOUT_MS
        int "Backend health timeout in milliseconds"
        default 10000
        range 1000 120000
        help
            Maximum time to wait for the backend health request.

    config VOICE_CHAT_TIMEOUT_MS
        int "Backend chat stream timeout in milliseconds"
        default 120000
        range 1000 300000
        help
            Maximum time to wait for one uploaded audio chat stream.

    config VOICE_SSE_LINE_MAX_BYTES
        int "Maximum SSE data line size in bytes"
        default 2621440
        range 4096 5242880
        help
            Maximum size for one backend SSE data line. WAV audio_base64 can be large.

    config VOICE_PLAY_VOLUME
        int "Speaker playback volume"
        default 40
        range 0 100
        help
            Speaker output volume passed to the ES8311 codec.

endmenu
```

## esp32-voice-assistant/firmware/esp32-s3/sdkconfig.defaults
```kconfig
CONFIG_PARTITION_TABLE_CUSTOM=y
CONFIG_PARTITION_TABLE_CUSTOM_FILENAME="partitions.csv"
CONFIG_PARTITION_TABLE_FILENAME="partitions.csv"
CONFIG_PARTITION_TABLE_OFFSET=0x8000
CONFIG_ESPTOOLPY_FLASHSIZE_16MB=y
CONFIG_ESPTOOLPY_FLASHSIZE="16MB"

CONFIG_SPIRAM=y
CONFIG_SPIRAM_MODE_OCT=y
CONFIG_SPIRAM_TYPE_AUTO=y
CONFIG_SPIRAM_CLK_IO=30
CONFIG_SPIRAM_CS_IO=26
CONFIG_SPIRAM_SPEED_80M=y
CONFIG_SPIRAM_USE_MALLOC=y
CONFIG_SPIRAM_MALLOC_ALWAYSINTERNAL=1024
CONFIG_SPIRAM_MALLOC_RESERVE_INTERNAL=32768
CONFIG_SPIRAM_ALLOW_STACK_EXTERNAL_MEMORY=y
CONFIG_ESP32S3_SPIRAM_SUPPORT=y
CONFIG_ESP_MAIN_TASK_STACK_SIZE=8192

CONFIG_SR_WN_WN9_ALEXA=y
CONFIG_SR_NSN_WEBRTC=y
CONFIG_SR_VADN_WEBRTC=y
CONFIG_SR_MN_CN_NONE=y
CONFIG_SR_MN_EN_NONE=y
```
